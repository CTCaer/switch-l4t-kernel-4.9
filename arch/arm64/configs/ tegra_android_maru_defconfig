## arch/arm64/configs/tegra_android_maru_defconfig
```kconfig
CONFIG_NAMESPACES=y
CONFIG_SYSVIPC=y
CONFIG_UTS_NS=y
CONFIG_PID_NS=y
CONFIG_USER_NS=y
CONFIG_IOSCHED_DEADLINE=y
# CONFIG_DEFAULT_CFQ is not set
CONFIG_DEFAULT_DEADLINE=y
CONFIG_THERMAL_GOV_CONTINUOUS=y
```

## backports/Kconfig
```kconfig
config BACKPORT_INTEGRATE
	bool
	def_bool y

config BACKPORT_DIR
	string
	default "backports/"

config BACKPORT_VERSION
	string
	default "v4.14-rc2-1-31-gaae6cd68"

config BACKPORT_KERNEL_VERSION
	string
	default "v4.14-rc2-0-ge19b205be43d"

config BACKPORT_KERNEL_NAME
	string
	default "Linux"

menuconfig BACKPORT_LINUX
	bool "Backport Linux v4.14-rc2-0-ge19b205be43d (backports v4.14-rc2-1-31-gaae6cd68)"
	default n
	---help---
	  Enabling this will let give you the opportunity to use features and
	  drivers backported from Linux v4.14-rc2-0-ge19b205be43d
	  on the kernel your are using. This is experimental and you should
	  say no unless you'd like to help test things or want to help debug
	  this should we run into any issues.

if BACKPORT_LINUX

source "$BACKPORT_DIR/Kconfig.versions"
source "$BACKPORT_DIR/Kconfig.sources"
#source "$BACKPORT_DIR/Kconfig.local"

endif # BACKPORT_LINUX
```

## backports/drivers/net/wireless/broadcom/brcm80211/Kconfig
```kconfig
config BACKPORT_BRCMUTIL
	tristate
	depends on m

config BACKPORT_BRCMSMAC
	depends on n
	tristate "Broadcom IEEE802.11n PCIe SoftMAC WLAN driver"
	depends on m
	depends on MAC80211
	depends on BCMA_POSSIBLE
	depends on BCMA
	select NEW_LEDS if BCMA_DRIVER_GPIO
	select LEDS_CLASS if BCMA_DRIVER_GPIO
	select BRCMUTIL
	depends on FW_LOADER
	select BPAUTO_CORDIC
	---help---
	  This module adds support for PCIe wireless adapters based on Broadcom
	  IEEE802.11n SoftMAC chipsets. It also has WLAN led support, which will
	  be available if you select BCMA_DRIVER_GPIO. If you choose to build a
	  module, the driver will be called brcmsmac.ko.

config BACKPORT_BRCMFMAC
	tristate "Broadcom FullMAC WLAN driver"
	depends on m
	depends on BACKPORT_CFG80211
	select BACKPORT_BRCMUTIL
	---help---
	  This module adds support for wireless adapters based on Broadcom
	  FullMAC chipsets. It has to work with at least one of the bus
	  interface support. If you choose to build a module, it'll be called
	  brcmfmac.ko.

config BRCMFMAC_PROTO_BCDC
	bool

config BRCMFMAC_PROTO_MSGBUF
	bool

config BACKPORT_BRCMFMAC_SDIO
	bool "SDIO bus interface support for FullMAC driver"
	depends on (MMC = y || MMC = BACKPORT_BRCMFMAC)
	depends on BACKPORT_BRCMFMAC
	select BACKPORT_BRCMFMAC_PROTO_BCDC
	depends on FW_LOADER
	default y
	---help---
	  This option enables the SDIO bus interface support for Broadcom
	  IEEE802.11n embedded FullMAC WLAN driver. Say Y if you want to
	  use the driver for a SDIO wireless card.

config BRCMFMAC_USB
	bool "USB bus interface support for FullMAC driver"
	depends on (USB = y || USB = BACKPORT_BRCMFMAC)
	depends on BACKPORT_BRCMFMAC
	select BACKPORT_BRCMFMAC_PROTO_BCDC
	depends on FW_LOADER
	---help---
	  This option enables the USB bus interface support for Broadcom
	  IEEE802.11n embedded FullMAC WLAN driver. Say Y if you want to
	  use the driver for an USB wireless card.

config BRCMFMAC_PCIE
	bool "PCIE bus interface support for FullMAC driver"
	depends on BACKPORT_BRCMFMAC
	depends on PCI
	depends on HAS_DMA
	select BACKPORT_BRCMFMAC_PROTO_MSGBUF
	depends on FW_LOADER
	---help---
	  This option enables the PCIE bus interface support for Broadcom
	  IEEE802.11ac embedded FullMAC WLAN driver. Say Y if you want to
	  use the driver for an PCIE wireless card.

config BACKPORT_BRCM_TRACING
	bool "Broadcom device tracing"
	depends on BACKPORT_BRCMSMAC || BACKPORT_BRCMFMAC
	---help---
	  If you say Y here, the Broadcom wireless drivers will register
	  with ftrace to dump event information into the trace ringbuffer.
	  Tracing can be enabled at runtime to aid in debugging wireless
	  issues. This option adds a small amount of overhead when tracing
	  is disabled. If unsure, say Y to allow developers to better help
	  you when wireless problems occur.

config BACKPORT_BRCMDBG
	bool "Broadcom driver debug functions"
	depends on BACKPORT_BRCMSMAC || BACKPORT_BRCMFMAC
	select BACKPORT_BPAUTO_WANT_DEV_COREDUMP
	---help---
	  Selecting this enables additional code for debug purposes.

config BACKPORT_BRCMFMAC_ANDROID
	bool "brcmfmac android support"
	depends on BACKPORT_BRCMFMAC
	---help---
	  If you say Y here, the FMAC driver will support Android mode

config BACKPORT_BRCM_INSMOD_NO_FW
	bool "insmod module without loading firmware"
	depends on BACKPORT_BRCMFMAC_ANDROID
	---help---
	  If you say Y here, the FMAC driver will not load firmware when
	  inserting the module, it only create wlan interface. Firmware
	  will be loaded when wlan interface up.

config BACKPORT_NV_CUSTOM_SYSFS_TEGRA
	bool "Custom sysfs for Tegra platform"
	depends on BACKPORT_BRCMFMAC
	default y
	---help---
	  Enable custom sysfs for Tegra platform.

config BACKPORT_NV_CUSTOM_CAP
	bool "NvCap support for Tegra platform"
	depends on BACKPORT_NV_CUSTOM_SYSFS_TEGRA
	default y
	---help---
	  Enable custom NvCap support for Tegra platform.

config BACKPORT_BRCMFMAC_NV_IDS
	bool "Nv IDS support for Tegra platform"
	depends on BACKPORT_NV_CUSTOM_SYSFS_TEGRA
	default y
	---help---
	  Enable NV IDS support for Tegra platform.

config BACKPORT_NV_CUSTOM_SCAN
	bool "scan optimization support"
	depends on BACKPORT_NV_CUSTOM_SYSFS_TEGRA
	default y
	---help---
	  Enable custom scan optimization support for Tegra platform.

config BACKPORT_NV_NET_BW_EST_TEGRA
	bool "bandwidth estimation support for netdiag"
	depends on BACKPORT_NV_NET_DIAG_TEGRA
	depends on BACKPORT_NV_CUSTOM_SYSFS_TEGRA
	default y
	---help---
	  Enable bandwidth estimation support for netdiag

config BACKPORT_NV_NET_DIAG_TEGRA
	bool "netdiag support"
	depends on BACKPORT_BRCMFMAC_ANDROID
	depends on BACKPORT_NV_CUSTOM_SYSFS_TEGRA
	default y
	---help---
	  Enable netdiag support

config BACKPORT_NV_CUSTOM_RF_TEST
	bool "RF test support for Tegra platform"
	depends on BACKPORT_NV_CUSTOM_SYSFS_TEGRA
	default y
	---help---
	  Enable RF test support for Tegra platform.
```

## backports/drivers/nfc/Kconfig
```kconfig
#
# Near Field Communication (NFC) devices
#

menu "Near Field Communication (NFC) devices"
	depends on BACKPORT_NFC

config BACKPORT_NFC_TRF7970A
	tristate "Texas Instruments TRF7970a NFC driver"
	depends on !NFC_TRF7970A
	depends on SPI && BACKPORT_NFC_DIGITAL && GPIOLIB
	help
	  This option enables the BACKPORT_NFC driver for Texas Instruments' TRF7970a
	  device. Such device supports 5 different protocols: ISO14443A,
	  ISO14443B, FeLiCa, ISO15693 and ISO18000-3.

	  Say Y here to compile support for TRF7970a into the kernel or
	  say M  to compile it as a module. The module will be called
	  trf7970a.ko.

config BACKPORT_NFC_MEI_PHY
	tristate "MEI bus NFC device support"
	depends on !NFC_MEI_PHY
	depends on INTEL_MEI && BACKPORT_NFC_HCI
	help
	  This adds support to use an mei bus nfc device. Select this if you
	  will use an HCI BACKPORT_NFC driver for an BACKPORT_NFC chip connected behind an
	  Intel's Management Engine chip.

	  If unsure, say N.

config BACKPORT_NFC_SIM
	tristate "NFC hardware simulator driver"
	depends on !NFC_SIM
	depends on BACKPORT_NFC_DIGITAL
	help
	  This driver declares two virtual BACKPORT_NFC devices supporting BACKPORT_NFC-DEP
	  protocol. An LLCP connection can be established between them and
	  all packets sent from one device is sent back to the other, acting as
	  loopback devices.

	  If unsure, say N.

config BACKPORT_NFC_PORT100
	tristate "Sony NFC Port-100 Series USB device support"
	depends on !NFC_PORT100
	depends on USB
	depends on BACKPORT_NFC_DIGITAL
	help
	  This adds support for Sony Port-100 chip based USB devices such as the
	  RC-S380 dongle.

	  If unsure, say N.

source "$BACKPORT_DIR/drivers/nfc/fdp/Kconfig"
source "$BACKPORT_DIR/drivers/nfc/pn544/Kconfig"
source "$BACKPORT_DIR/drivers/nfc/pn533/Kconfig"
source "$BACKPORT_DIR/drivers/nfc/microread/Kconfig"
source "$BACKPORT_DIR/drivers/nfc/nfcmrvl/Kconfig"
source "$BACKPORT_DIR/drivers/nfc/st21nfca/Kconfig"
source "$BACKPORT_DIR/drivers/nfc/st-nci/Kconfig"
source "$BACKPORT_DIR/drivers/nfc/nxp-nci/Kconfig"
source "$BACKPORT_DIR/drivers/nfc/s3fwrn5/Kconfig"
source "$BACKPORT_DIR/drivers/nfc/st95hf/Kconfig"
endmenu
```

## backports/drivers/nfc/fdp/Kconfig
```kconfig
config BACKPORT_NFC_FDP
	tristate "Intel FDP NFC driver"
	depends on !NFC_FDP
	depends on BACKPORT_NFC_NCI
	depends on CRC_CCITT
	default n
	---help---
	  Intel Fields Peak BACKPORT_NFC controller core driver.
	  This is a driver based on the NCI BACKPORT_NFC kernel layers.

	  To compile this driver as a module, choose m here. The module will
	  be called fdp.
	  Say N if unsure.

config BACKPORT_NFC_FDP_I2C
	tristate "NFC FDP i2c support"
	depends on !NFC_FDP_I2C
	depends on BACKPORT_NFC_FDP && I2C
	---help---
	  This module adds support for the Intel Fields Peak BACKPORT_NFC controller
	  i2c interface.
	  Select this if your platform is using the i2c bus.

	  If you choose to build a module, it'll be called fdp_i2c.
	  Say N if unsure.
```

## backports/drivers/nfc/microread/Kconfig
```kconfig
config BACKPORT_NFC_MICROREAD
	tristate
	depends on !NFC_MICROREAD
	depends on CRC_CCITT
	---help---
	  This module contains the main code for Inside Secure microread
	  BACKPORT_NFC chipsets. It implements the chipset HCI logic and hooks into
	  the BACKPORT_NFC kernel APIs. Physical layers will register against it.

config BACKPORT_NFC_MICROREAD_I2C
	tristate "Inside Secure Microread device support (I2C)"
	depends on !NFC_MICROREAD_I2C
	depends on BACKPORT_NFC_HCI && I2C && BACKPORT_NFC_SHDLC
	select BACKPORT_NFC_MICROREAD
	---help---
	  This module adds support for the i2c interface of adapters using
	  Inside microread chipsets.  Select this if your platform is using
	  the i2c bus.

	  If you choose to build a module, it'll be called microread_i2c.
	  Say N if unsure.

config BACKPORT_NFC_MICROREAD_MEI
	tristate "Inside Secure Microread device support (MEI)"
	depends on !NFC_MICROREAD_MEI
	depends on BACKPORT_NFC_HCI && BACKPORT_NFC_MEI_PHY
	select BACKPORT_NFC_MICROREAD
	---help---
	  This module adds support for the mei interface of adapters using
	  Inside microread chipsets.  Select this if your microread chipset
	  is handled by Intel's Management Engine Interface on your platform.

	  If you choose to build a module, it'll be called microread_mei.
	  Say N if unsure.
```

## backports/drivers/nfc/nfcmrvl/Kconfig
```kconfig
config BACKPORT_NFC_MRVL
	tristate
	depends on !NFC_MRVL
	help
	  The core driver to support Marvell BACKPORT_NFC devices.

	  This driver is required if you want to support
	  Marvell BACKPORT_NFC device 8897.

config BACKPORT_NFC_MRVL_USB
	tristate "Marvell NFC-over-USB driver"
	depends on !NFC_MRVL_USB
	depends on BACKPORT_NFC_NCI && USB
	select BACKPORT_NFC_MRVL
	help
	  Marvell BACKPORT_NFC-over-USB driver.

	  This driver provides support for Marvell BACKPORT_NFC-over-USB devices:
          8897.

	  Say Y here to compile support for Marvell BACKPORT_NFC-over-USB driver
	  into the kernel or say M to compile it as module.

config BACKPORT_NFC_MRVL_UART
	tristate "Marvell NFC-over-UART driver"
	depends on !NFC_MRVL_UART
	depends on BACKPORT_NFC_NCI && BACKPORT_NFC_NCI_UART
	select BACKPORT_NFC_MRVL
	help
	  Marvell BACKPORT_NFC-over-UART driver.

	  This driver provides support for Marvell BACKPORT_NFC-over-UART devices

	  Say Y here to compile support for Marvell BACKPORT_NFC-over-UART driver
	  into the kernel or say M to compile it as module.

config BACKPORT_NFC_MRVL_I2C
	tristate "Marvell NFC-over-I2C driver"
	depends on !NFC_MRVL_I2C
	depends on BACKPORT_NFC_MRVL && I2C
	help
	  Marvell BACKPORT_NFC-over-I2C driver.

	  This driver provides support for Marvell BACKPORT_NFC-over-I2C devices.

	  Say Y here to compile support for Marvell BACKPORT_NFC-over-I2C driver
	  into the kernel or say M to compile it as module.

config BACKPORT_NFC_MRVL_SPI
	tristate "Marvell NFC-over-SPI driver"
	depends on !NFC_MRVL_SPI
	depends on BACKPORT_NFC_MRVL && BACKPORT_NFC_NCI_SPI
	help
	  Marvell BACKPORT_NFC-over-SPI driver.

	  This driver provides support for Marvell BACKPORT_NFC-over-SPI devices.

	  Say Y here to compile support for Marvell BACKPORT_NFC-over-SPI driver
	  into the kernel or say M to compile it as module.
```

## backports/drivers/nfc/pn544/Kconfig
```kconfig
config BACKPORT_NFC_PN544
	tristate
	depends on !NFC_PN544
	depends on CRC_CCITT
	---help---
	  NXP PN544 core driver.
	  This is a driver based on the HCI BACKPORT_NFC kernel layers and
	  will thus not work with NXP libnfc library.

config BACKPORT_NFC_PN544_I2C
	tristate "NXP PN544 device support (I2C)"
	depends on !NFC_PN544_I2C
	depends on BACKPORT_NFC_HCI && I2C && BACKPORT_NFC_SHDLC
	select BACKPORT_NFC_PN544
	---help---
	  This module adds support for the NXP pn544 i2c interface.
	  Select this if your platform is using the i2c bus.

	  If you choose to build a module, it'll be called pn544_i2c.
	  Say N if unsure.

config BACKPORT_NFC_PN544_MEI
	tristate "NXP PN544 device support (MEI)"
	depends on !NFC_PN544_MEI
	depends on BACKPORT_NFC_HCI && BACKPORT_NFC_MEI_PHY
	select BACKPORT_NFC_PN544
	---help---
	  This module adds support for the mei interface of adapters using
	  NXP pn544 chipsets.  Select this if your pn544 chipset
	  is handled by Intel's Management Engine Interface on your platform.

	  If you choose to build a module, it'll be called pn544_mei.
	  Say N if unsure.
```

## backports/drivers/nfc/st-nci/Kconfig
```kconfig
config BACKPORT_NFC_ST_NCI
	tristate
	depends on !NFC_ST_NCI
	---help---
	  STMicroelectronics BACKPORT_NFC NCI chips core driver. It implements the chipset
	  NCI logic and hooks into the BACKPORT_NFC kernel APIs. Physical layers will
	  register against it.

config BACKPORT_NFC_ST_NCI_I2C
	tristate "STMicroelectronics ST NCI NFC driver (I2C)"
	depends on !NFC_ST_NCI_I2C
	depends on BACKPORT_NFC_NCI && I2C
	select BACKPORT_NFC_ST_NCI
	---help---
	  This module adds support for an I2C interface to the
	  STMicroelectronics BACKPORT_NFC NCI chips familly.
	  Select this if your platform is using the i2c bus.

	  If you choose to build a module, it'll be called st-nci_i2c.
	  Say N if unsure.

config BACKPORT_NFC_ST_NCI_SPI
	tristate "STMicroelectronics ST NCI NFC driver (SPI)"
	depends on !NFC_ST_NCI_SPI
	depends on BACKPORT_NFC_NCI && SPI
	select BACKPORT_NFC_ST_NCI
	---help---
	  This module adds support for an SPI interface to the
	  STMicroelectronics BACKPORT_NFC NCI chips familly.
	  Select this if your platform is using the spi bus.

	  If you choose to build a module, it'll be called st-nci_spi.
	  Say N if unsure.
```

## backports/drivers/nfc/st21nfca/Kconfig
```kconfig
config BACKPORT_NFC_ST21NFCA
	tristate
	depends on !NFC_ST21NFCA
	depends on CRC_CCITT
	---help---
	  STMicroelectronics ST21NFCA core driver. It implements the chipset
	  HCI logic and hooks into the BACKPORT_NFC kernel APIs. Physical layers will
	  register against it.

config BACKPORT_NFC_ST21NFCA_I2C
	tristate "STMicroelectronics ST21NFCA NFC driver (I2C)"
	depends on !NFC_ST21NFCA_I2C
	depends on BACKPORT_NFC_HCI && I2C && BACKPORT_NFC_SHDLC
	select BACKPORT_NFC_ST21NFCA
	---help---
	  This module adds support for the STMicroelectronics st21nfca i2c interface.
	  Select this if your platform is using the i2c bus.

	  If you choose to build a module, it'll be called st21nfca_i2c.
	  Say N if unsure.
```
