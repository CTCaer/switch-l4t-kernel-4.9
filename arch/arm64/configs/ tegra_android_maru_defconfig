## arch/arm64/configs/ tegra_android_maru_defconfig
```kconfig
CONFIG_NAMESPACES=y
CONFIG_SYSVIPC=y
CONFIG_UTS_NS=y
CONFIG_PID_NS=y
CONFIG_USER_NS=y
```

## arch/arm64/configs/t186_variant_defconfig
```kconfig
# CONFIG_TRUSTY is not set
# CONFIG_TRUSTED_LITTLE_KERNEL is not set
# CONFIG_TEGRA_HDMIHDCP is not set
#_CONFIG_TEGRA_DPHDCP is not set
```
